## config/boards/shields/cardinal1/Kconfig.defconfig
```kconfig
if SHIELD_cardinal1_left

# Name must be less than 16 characters long!
config ZMK_KEYBOARD_NAME
    default "Cardinalv1"

config ZMK_SPLIT_ROLE_CENTRAL
    default y

endif

if SHIELD_cardinal1_left || SHIELD_cardinal1_right

config ZMK_SPLIT
    default y

endif
```

## config/boards/shields/cardinal1/Kconfig.shield
```kconfig
# No whitespace after the comma or in your part name!
config SHIELD_cardinal1_left
    def_bool $(shields_list_contains,cardinal1_left)

# No whitespace after the comma or in your part name!
config SHIELD_cardinal1_right
    def_bool $(shields_list_contains,cardinal1_right)
```
